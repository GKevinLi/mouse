## firmware/Kconfig
```kconfig
#
# Copyright (c) 2018 Nordic Semiconductor
#
# SPDX-License-Identifier: LicenseRef-Nordic-5-Clause
#

menu "Nordic HIDS BLE GATT mouse service sample"

config SAMPLE_BT_HIDS_SECURITY
	bool "Bluetooth LE security"
	default y
	imply BT_PRIVACY
	select BT_SMP
	select BT_SETTINGS
	select FLASH
	select FLASH_PAGE_LAYOUT
	select FLASH_MAP
	select SETTINGS
	imply ZMS if (SOC_FLASH_NRF_RRAM || SOC_FLASH_NRF_MRAM)
	imply NVS if !(SOC_FLASH_NRF_RRAM || SOC_FLASH_NRF_MRAM)
	help
	  Enable Bluetooth LE security support.

config SAMPLE_BT_HIDS_SECURITY_MITM
	bool "Passkey display MITM protection"
	depends on SAMPLE_BT_HIDS_SECURITY
	depends on PRINTK
	default n
	help
	  Enable displaying passkey for Man-In-The-Middle (MITM) protection.
	  Implementation uses the "printk" function to display the passkey.

config SAMPLE_BT_DIRECTED_ADVERTISING
	bool "Directed advertising"
	default y
	depends on SAMPLE_BT_HIDS_SECURITY

config BOARD_ENABLE_DCDC
    bool "Enable DCDC mode"
    default n
    select SOC_DCDC_NRF52X
    depends on BOARD_NRF52833DK_NRF52833

endmenu

source "Kconfig.zephyr"
```
